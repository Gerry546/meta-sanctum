## wic/qemuarm64-a72.wks
```
# short-description: Create Qemu disk image
# long-description: Creates a partitioned Qemu disk image consisting of
# - 2x boot partition
# - empty partition for the u-boot env
# - 2x rootfs partition
# - data partition

bootloader --ptable gpt

# Boot partition
part --source bootimg-partition --ondisk vda --fstype vfat --label boot_A --active --align 4096 --fixed-size 50M
part --source bootimg-partition --ondisk vda --fstype vfat --label boot_B --active --align 4096 --fixed-size 50M

# Data storage for persistent data such as uboot environment
part --fixed-size 10M --ondisk vda --align 4096 --label uboot-env --fstype vfat

# Rootfs
part / --fixed-size 2G --source rootfs --ondisk vda --fstype=ext4 --label root_a --align 4096

# Redundant rootfs
part / --fixed-size 2G --source rootfs --ondisk vda --fstype=ext4 --label root_b --align 4096

part --fixed-size 100M --ondisk vda --fstype=ext4 --label=data --align 4096
```

## wic/reterminal.wks
```
# short-description: Create Reterminal disk image
# long-description: Creates a partitioned Reterminal disk image consisting of
# - boot partition
# - data partition
# - 2x rootfs partition

# Bootloader configuratio
bootloader --ptable gpt

# Boot partition
part    --source bootimg-partition --fixed-size 100M    --ondisk mmcblk0 --fstype=vfat --label boot     --align 4096 --active

# Data partition
part    --source rootfs            --fixed-size 100M    --ondisk mmcblk0 --fstype=ext4 --label data     --align 4096 --rootfs-dir=${IMAGE_ROOTFS}/data 

# Rootfs & redudant rootfs
part /  --source rootfs            --fixed-size 5G      --ondisk mmcblk0 --fstype=ext4 --label rootfs_A --align 4096 --exclude-path=data/
part /  --source rootfs            --fixed-size 5G      --ondisk mmcblk0 --fstype=ext4 --label rootfs_B --align 4096 --exclude-path=data/
```
