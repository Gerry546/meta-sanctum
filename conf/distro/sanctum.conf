## conf/distro/sanctum.conf
```bitbake
# Generic information
################################
DISTRO = "sanctum"
DISTRO_NAME = "sanctum"
DISTRO_VERSION = "1"
SDK_VENDOR = "-sanctumsdk"
MAINTAINER = "Tom Geelen <t.f.g.geelen@gmail.com>"

# Distro tweaking
################################
DISTRO_FEATURES = "\
    bluetooth \
    ipv4 \
    opengl \
    pam \
    pci \
    ptest \
    systemd \
    rauc \
    usbgadget \
    usbhost \
    usrmerge \
    vfat \
    wayland \
    wifi \
    xattr \
    zeroconf \
"

PREFERRED_PROVIDER_virtual/bootloader:qemuarm64 = "u-boot"
PREFERRED_PROVIDER_virtual/kernel:qemuarm64 = "linux-yocto"
PREFERRED_PROVIDER_virtual/kernel:reterminal = "linux-raspberrypi"

# Include list of CVE's which can be ignored
include conf/distro/include/cve-extra-exclusions.inc

# Let's ensure all is dynamically linked
require conf/distro/include/no-static-libs.inc

# And add some security flags
require conf/distro/include/security_flags.inc
require conf/distro/include/rust_security_flags.inc

# Prevent stacking up old builds and do not symlink everything
IMAGE_NAME:reterminal = "${IMAGE_BASENAME}${IMAGE_MACHINE_SUFFIX}${IMAGE_NAME_SUFFIX}"
IMAGE_LINK_NAME:reterminal = ""

# Default the temp directory name in the build folder to tmp
TCLIBCAPPEND = ""
```

## conf/machine/qemux86-64.conf
```bitbake
#@TYPE: Machine
#@NAME: QEMU x86-64 machine
#@DESCRIPTION: Machine configuration for running an x86-64 system on QEMU

# Machine settings
#########################################

PREFERRED_PROVIDER_virtual/xserver ?= "xserver-xorg"
PREFERRED_PROVIDER_virtual/libgl ?= "mesa"
PREFERRED_PROVIDER_virtual/libgles1 ?= "mesa"
PREFERRED_PROVIDER_virtual/libgles2 ?= "mesa"
PREFERRED_PROVIDER_virtual/libgles3 ?= "mesa"
PREFERRED_RPROVIDER_virtual-grub-bootconf = "rauc-qemu-grubconf"

require conf/machine/include/qemu.inc
DEFAULTTUNE ?= "core2-64"
require conf/machine/include/x86/tune-x86-64-v3.inc
require conf/machine/include/x86/qemuboot-x86.inc

SERIAL_CONSOLES ?= "115200;ttyS0 115200;ttyS1"

# Install swrast and glx if opengl is in DISTRO_FEATURES and x32 is not in use.
# This is because gallium swrast driver was found to crash X server on startup in qemu x32.
XSERVER = "xserver-xorg \
           ${@bb.utils.contains('DISTRO_FEATURES', 'opengl', \
           bb.utils.contains('TUNE_FEATURES', 'mx32', '', 'mesa-driver-swrast xserver-xorg-extension-glx', d), '', d)} \
           xf86-video-cirrus \
           xf86-video-fbdev \
           xf86-video-vmware \
           xf86-video-modesetting \
           xf86-video-vesa \
           xserver-xorg-module-libint10 \
           "

MACHINE_FEATURES += "\
    x86 \
    pci \
    pcbios \
    efi \
"

MACHINE_ESSENTIAL_EXTRA_RDEPENDS += "v86d"

MACHINE_EXTRA_RRECOMMENDS = "kernel-module-snd-ens1370 kernel-module-snd-rawmidi"

# WIC Settings
#########################################
WKS_FILE ?= "qemux86-grub-efi.wks"

do_image_wic[depends] += "\
    syslinux:do_populate_sysroot \
    syslinux-native:do_populate_sysroot \
    mtools-native:do_populate_sysroot \
    dosfstools-native:do_populate_sysroot \
    boot-image:do_deploy \
"

IMAGE_FSTYPES:append = " \
    wic \
"

EXTRA_IMAGEDEPENDS += "ovmf"

# Bootloader settings
#########################################
UBOOT_MACHINE ?= "qemu-x86_64_defconfig"

KERNEL_IMAGETYPE = "bzImage"

#For runqemu
QB_SYSTEM_NAME = "qemu-system-x86_64"
```

## conf/machine/reterminal-qemuarm64-a72.conf
```bitbake
#@TYPE: Machine
#@NAME: QEMU ARMv8 machine based on A72 tuning 
#@DESCRIPTION: Machine configuration for running an ARMv8 system on QEMU

MACHINEOVERRIDES = "qemuarm64:${MACHINE}"

require conf/machine/qemuarm64.conf

KMACHINE = "qemuarm64"

UBOOT_EXTLINUX = "0"
KERNEL_BOOTCMD = "bootm"

QB_TCPSERIAL_OPT = "-device virtio-serial-pci -chardev socket,id=virtcon,port=@PORT@,host=127.0.0.1,nodelay=on -device virtconsole,chardev=virtcon"
# Set bootloader file
QB_DEFAULT_BIOS = "u-boot.bin"
QB_FSINFO = "wic:no-kernel-in-fs"
QB_DEFAULT_FSTYPE = "wic"
```

## conf/machine/reterminal.conf
```bitbake
#@TYPE: Machine
#@NAME: Reterminal machine based on a Raspberry Pi CM4
#@DESCRIPTION: Machine configuration for running a reterminal

MACHINEOVERRIDES = "raspberrypi4:raspberrypi4-64:${MACHINE}"

require conf/machine/raspberrypi4-64.conf

# Machine settings
#########################################

MACHINE_FEATURES:append = "\
    bluetooth \
    rtc \
    screen \
    serial \
    touchscreen \
    usbgadget \
    usbhost \
    vfat \
    wifi \
"

IMAGE_FSTYPES = " \
    wic \
    wic.bz2 \
    wic.bmap \
    ext4 \
"

###########################################################################
# As it is a raspberry pi product we need to enable the configuration and
# ensure that the overlay is loaded

# Enable UART communication
ENABLE_UART = "1"

# Enable the USB ports at the side
ENABLE_DWC2_HOST = "1"

# I2C1 is used for:
#   Display
#   Light sensor
#   Accelerometer
# I2C3 is used for:
#   RTC
#   Encryption sensor
ENABLE_I2C = "1"
ENABLE_I2C3 = "1"
RPI_KERNEL_DEVICETREE_OVERLAYS:append = " \
    overlays/i2c3.dtbo \
"
KERNEL_MODULE_AUTOLOAD += " i2c-dev i2c-bcm2835"

# Add the overlay which contains the specifics for the reterminal
ENABLE_RETERMINAL = "1"
RPI_KERNEL_DEVICETREE_OVERLAYS:append = " \
    overlays/reterminal.dtbo \
"

# # SPI is used 
# #   40 pins I/O connector
# ENABLE_SPI_BUS = "1"


# Bootloader settings
#########################################
# Default for the distro to U-Boot
RPI_USE_U_BOOT = "1"

# WIC Settings
#########################################
WKS_FILES = "reterminal.wks"
```

## meta-sanctum/conf/distro/sanctum-dev.conf
```bitbake
require sanctum-test.conf

DISTRO = "sanctum-dev"
DISTRO_NAME = "sanctum-dev" 
DISTROOVERRIDES = "sanctum:sanctum-test:sanctum-dev"
```

## meta-sanctum/conf/distro/sanctum-test.conf
```bitbake
require sanctum.conf

DISTRO = "sanctum-test"
DISTRO_NAME = "sanctum-test" 
DISTROOVERRIDES = "sanctum:sanctum-test"

DISTRO_FEATURES:append = "\
    ptest \
"
```

## meta-sanctum/conf/distro/sanctum.conf
```bitbake
# Generic information
################################
DISTRO = "sanctum"
DISTRO_NAME = "sanctum"
DISTRO_VERSION = "1"
SDK_VENDOR = "-sanctumsdk"
MAINTAINER = "Tom Geelen <t.f.g.geelen@gmail.com>"

# Distro tweaking
################################
DISTROOVERRIDES = "sanctum"

DISTRO_FEATURES = "\
    bluetooth \
    ipv4 \
    opengl \
    pam \
    pci \
    rauc \
    usbgadget \
    usbhost \
    vfat \
    virtualization \
    wayland \
    wifi \
    xattr \
    zeroconf \
"

PREFERRED_PROVIDER_virtual/bootloader:qemuarm64 = "u-boot"
PREFERRED_PROVIDER_virtual/kernel:qemuall = "linux-yocto"
PREFERRED_PROVIDER_virtual/kernel:reterminal = "linux-raspberrypi"

PREFERRED_PROVIDER:pn-nativesdk-libsdl2 = "nativesdk-libsdl2"

# Include list of CVE's which can be ignored
include conf/distro/include/cve-extra-exclusions.inc

# Let's ensure all is dynamically linked
require conf/distro/include/no-static-libs.inc

# Add systemd as init-manager
INIT_MANAGER = "systemd"

# And add some security flags
require conf/distro/include/security_flags.inc
require conf/distro/include/rust_security_flags.inc

# Prevent stacking up old builds and do not symlink everything
IMAGE_NAME = "${IMAGE_BASENAME}"
IMAGE_LINK_NAME = ""

FORTRAN:forcevariable = ",fortran"
RUNTIMETARGET:append:pn-gcc-runtime = " libquadmath"
HOSTTOOLS += "gfortran"

BBMASK += "recipes-python/fsspec/python3-fsspec_2025.5.1.bbappend"
```

## meta-sanctum/conf/layer.conf
```bitbake
# We have a conf and classes directory, add to BBPATH
BBPATH .= ":${LAYERDIR}"

# We have recipes-* directories, add to BBFILES
BBFILES += "${LAYERDIR}/recipes-*/*/*.bb \
            ${LAYERDIR}/recipes-*/*/*.bbappend"

BBFILE_COLLECTIONS += "meta-sanctum"
BBFILE_PATTERN_meta-sanctum = "^${LAYERDIR}/"
BBFILE_PRIORITY_meta-sanctum = "20"

BBFILES_DYNAMIC += " \
    raspberrypi:${LAYERDIR}/dynamic-layers/raspberrypi-layer/*/*/*.bb \
    raspberrypi:${LAYERDIR}/dynamic-layers/raspberrypi-layer/*/*/*.bbappend \
    homeassistant:${LAYERDIR}/dynamic-layers/homeassistant-layer/*/*/*.bb \
    homeassistant:${LAYERDIR}/dynamic-layers/homeassistant-layer/*/*/*.bbappend \
    rauc:${LAYERDIR}/dynamic-layers/rauc-layer/*/*/*.bb \
    rauc:${LAYERDIR}/dynamic-layers/rauc-layer/*/*/*.bbappend \
    firefox-browser-layer:${LAYERDIR}/dynamic-layers/firefox-layer/*/*/*.bb \
    firefox-browser-layer:${LAYERDIR}/dynamic-layers/firefox-layer/*/*/*.bbappend \
"

LAYERDEPENDS_meta-sanctum = "core"
LAYERSERIES_COMPAT_meta-sanctum = "whinlatter"
```

## meta-sanctum/conf/machine/qemuarm64-a72.conf
```bitbake
#@TYPE: Machine
#@NAME: QEMU ARMv8 machine based on A72 tuning 
#@DESCRIPTION: Machine configuration for running an ARMv8 system on QEMU

MACHINEOVERRIDES = "qemuarm64:${MACHINE}"

require conf/machine/qemuarm64.conf

KMACHINE = "qemuarm64"

SERIAL_CONSOLES = "115200;ttyAMA0"
QB_KERNEL_CMDLINE_APPEND = "swiotlb=0 earlycon=pl011,0x9000000 ignore_loglevel loglevel=8"

WKS_FILE = "qemuarm64-a72.wks.in"
IMAGE_BOOT_FILES = "\
    u-boot.bin \
    boot.scr \
    fitImage \
"

do_image_wic[depends] += " \
    sanctum-bootfs:do_image_complete \
"

UBOOT_EXTLINUX = "0"
KERNEL_BOOTCMD = "bootm"

# Set bootloader file
QB_DEFAULT_BIOS = "u-boot.bin"
QB_FSINFO = "wic:no-kernel-in-fs"
QB_DEFAULT_FSTYPE = "wic"

IMAGE_FSTYPES:append = " \
    wic \
    wic.bmap \
"
```

## meta-sanctum/conf/machine/qemux86-64n.conf
```bitbake
#@TYPE: Machine
#@NAME: QEMU x86-64 machine
#@DESCRIPTION: Machine configuration for running an x86-64 system on QEMU

MACHINEOVERRIDES = "qemux86-64:${MACHINE}"

require conf/machine/qemux86-64.conf

PREFERRED_RPROVIDER_virtual-grub-bootconf = "rauc-qemu-grubconf"

MACHINE_FEATURES += "\
    pcbios \
    efi \
"

IMAGE_BOOT_FILES = "\
    grub.cfg \
    grub-efi-bootx64.efi;bootx64.efi \
"

KMACHINE = "qemux86-64"

WKS_FILE = "qemux86-64.wks.in"
do_image_wic[depends] += " \
    sanctum-bootfs:do_image_complete \
    sanctum-grubenv:do_image_complete \
"

EXTRA_IMAGEDEPENDS += "ovmf"
```

## meta-sanctum/conf/machine/reterminal-qemux86-64.conf
```bitbake
#@TYPE: Machine
#@NAME: QEMU x86-64 machine
#@DESCRIPTION: Machine configuration for running an x86-64 system on QEMU

MACHINEOVERRIDES = "qemux86-64:${MACHINE}"

require conf/machine/qemux86-64.conf

PREFERRED_RPROVIDER_virtual-grub-bootconf = "rauc-qemu-grubconf"

MACHINE_FEATURES += "\
    pcbios \
    efi \
"

KMACHINE = "qemux86-64"

WKS_FILE = "qemux86-grub-efi.wks"

EXTRA_IMAGEDEPENDS += "ovmf"
```

## meta-sanctum/conf/machine/reterminal.conf
```bitbake
#@TYPE: Machine
#@NAME: Reterminal machine based on a Raspberry Pi CM4
#@DESCRIPTION: Machine configuration for running a reterminal

MACHINEOVERRIDES = "raspberrypi4:raspberrypi4-64:${MACHINE}"

require conf/machine/raspberrypi4-64.conf

# Machine settings
#########################################

MACHINE_FEATURES:append = "\
    bluetooth \
    rtc \
    screen \
    serial \
    touchscreen \
    usbgadget \
    usbhost \
    vfat \
    wifi \
"

IMAGE_FSTYPES = " \
    wic \
    wic.bz2 \
    wic.bmap \
    ext4 \
"

###########################################################################
# As it is a raspberry pi product we need to enable the configuration and
# ensure that the overlay is loaded

RPI_KERNEL_DEVICETREE = " \
    broadcom/bcm2711-rpi-cm4.dtb \ 
"

# Enable UART communication
ENABLE_UART = "1"

# Enable the USB ports at the side
ENABLE_DWC2_HOST = "1"

# I2C1 is used for:
#   Accelerometer       (0x19)
#   Light sensor        (0x29)
#   IO Expander         (0x38)
#   Display             (0x45)
# I2C3 is used for:
#   RTC                 (0x51)
#   Encryption sensor
ENABLE_I2C = "1"
ENABLE_I2C3 = "1"
RPI_KERNEL_DEVICETREE_OVERLAYS:append = " \
    overlays/i2c3.dtbo \
"

# Add the overlay which contains the specifics for the reterminal
ENABLE_RETERMINAL = "1"
RPI_KERNEL_DEVICETREE_OVERLAYS:append = " \
    overlays/reterminal.dtbo \
"

# # SPI is used 
# #   40 pins I/O connector
# ENABLE_SPI_BUS = "1"


# Bootloader settings
#########################################
# Default for the distro to U-Boot
RPI_USE_U_BOOT = "1"

RPI_EXTRA_IMAGE_BOOT_FILES += "\
    fitImage \
"

do_image_wic[depends] += " \
    reterminal-fitimage:do_deploy \
"

RPI_EXTRA_IMAGE_BOOT_FILES:remove = "\
    ${KERNEL_IMAGETYPE} \
"

KERNEL_BOOTCMD = "bootm"

# WIC Settings
#########################################
WKS_FILES = "reterminal.wks"
```

## meta-sanctum/wic/qemuarm64-a72.wks
```
# short-description: Create Qemu disk image
# long-description: Creates a partitioned Qemu disk image consisting of
# - 2x boot partition
# - empty partition for the u-boot env
# - 2x rootfs partition
# - 2x data partition

bootloader --ptable gpt

# Boot partition
part --source bootimg-partition --ondisk vda --fstype vfat --label boot_A --active --align 4096 --fixed-size 50M
part --source bootimg-partition --ondisk vda --fstype vfat --label boot_B --active --align 4096 --fixed-size 50M

# Data storage for persistent data such as uboot environment
part --fixed-size 10M --ondisk vda --align 4096 --label uboot-env --fstype vfat

# Rootfs
part / --fixed-size 2G --source rootfs --exclude-path=data/ --ondisk vda --fstype=ext4 --label root_A --align 4096
part / --fixed-size 2G --source rootfs --exclude-path=data/ --ondisk vda --fstype=ext4 --label root_B --align 4096

# Data partitions
part /data --fixed-size 100M --source rootfs --ondisk vda --fstype=ext4 --rootfs-dir=${IMAGE_ROOTFS}/data --label data --align 4096
```

## meta-sanctum/wic/qemux86-grub-efi.wks
```
# short-description: Create Qemu disk image
# long-description: Creates a partitioned Qemu disk image for use with the RAUC update tool.

bootloader --ptable gpt

# Boot partition
part --fixed-size 50M --source rawcopy --sourceparams="file=efi-boot.vfat" --fstype=vfat --ondisk sda --label boot --active --align 4096
part --fixed-size 50M --ondisk sda --align 4096 --no-table

# Data storage for persistent data such as grubenv environment
part --fixed-size 10M --source rawcopy --sourceparams="file=grubenv.vfat" --fstype=vfat --ondisk sda --label grubenv --align 1024

# Rootfs
part / --fixed-size 2G --source rootfs --ondisk sda --fstype=ext4 --label root_a --align 4096

# Redundant Rootfs
part / --fixed-size 2G --source empty --ondisk sda --fstype=ext4 --label root_b --align 4096

part --fixed-size 100M --ondisk sda --fstype=ext4 --label data --align 4096
```

## meta-sanctum/wic/reterminal.wks
```
# short-description: Create Reterminal disk image
# long-description: Creates a partitioned Reterminal disk image consisting of
# - 2x boot partition
# - 2x rootfs partition
# - data partition

# Bootloader configuration
bootloader --ptable gpt

# Boot partition
part --source bootimg-partition --fixed-size 200M --ondisk mmcblk0 --fstype=vfat --label boot_A --align 4096 --active
part --source bootimg-partition --fixed-size 200M --ondisk mmcblk0 --fstype=vfat --label boot_B --align 4096

# Rootfs & redundant rootfs
part / --source rootfs --fixed-size 5G --ondisk mmcblk0 --fstype=ext4 --label rootfs_A --align 4096 --exclude-path=data/
part / --source rootfs --fixed-size 5G --ondisk mmcblk0 --fstype=ext4 --label rootfs_B --align 4096 --exclude-path=data/

# Data partition
part --source rootfs --fixed-size 17G --ondisk mmcblk0 --fstype=ext4 --label data --align 4096 --rootfs-dir=${IMAGE_ROOTFS}/data 
```
